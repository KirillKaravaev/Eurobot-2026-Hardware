/*-------------------------------------------------------------------------------------------------------------------
--
-- Проект      : SKUP5
-- Модуль      : DSPlib
-- Автор       : Караваев К.А.
-- Компания    : Nidec
-- Файлы       : DSPlib.h, DSPlib.c
---------------------------------------------------------------------------------------------------------------------
--
-- Описание    : Библиотека с различными вариантами цифровых фильтров и функций ЦОС
--
-- Функции	   : NBRF_calculate_coeff               - раcчет коэффициентов режекторного узкополосного фильтра 2 порядка
--               NBPF_calculate_coef                - раcчет коэффициентов полосового узкополосного фильтра 2 порядка
--               LowPassFilter_calculate_coef       - раcчет коэффициентов фильтра нижних частот порядка n
--               HighPassFilter_calculate_coef      - раcчет коэффициентов фильтра высоких частот порядка n
--               BandPassFilter_calculate_coef      - расчет коэффициентов полосового фильтра порядка n
--               BandRejectFilter_calculate_coef    - расчет коэффициентов режекторного фильтра порядка n
--               Calculate_coef                     - выбор одного из типов фильтров
--               Merge_filters                      - объединение последовательно или параллельно подключенных фильтров
--               Filter_sig                         - фильтрация входного сигнала с помощью рассчитанных коэффициентов
--               PID_calculate                      - функция ПИД-регулирования
--               Star_to_Triangle                   - функция преобразования звезды сопротивлений в треугольник
--               Triangle_to_Star                   - функция преобразования треугольника сопротивлений в звезду
--               Direct_Park_Transform              - функция прямого преобразования Парка (преобразования поворота СК)
--               Reverse_Park_Transform             - функция обратного преобразования Парка
--               Direct_Clarke_Transform            - функция прямого преобразования Кларка (преобразование 3-х фазной цепи в 2-х фазную)
--               Reverse_Clarke_Transform           - функция обратного преобразования Кларка (преобразование 2-х фазной цепи в 3-х фазную)
--               Rolling_Avg                        - функция вычисления скользящего среднего для целочисленных переменных
--               Rolling_Avg_а                      - функция вычисления скользящего среднего для
--               Sine_RMS                           - простая функция для вычисления среднеквадратичного значения синуса Irms = Iampl/sqrt2
--               RMS                                - функция вычисления среднеквадратичного значения произвольного сигнала
--               RMS_rst_err                        - функция сброса накопленной при вычислении RMS ошибки
--               RMS_f                              - функция вычисления среднеквадратичного значения произвольного сигнала типа float
--               RMS_f_rst_err                      - функция сброса накопленной при вычислении RMS ошибки сигнала типа float
--               Rate_Limiter                       - функция динамического ограничения скорости роста сигнала
--               Debounce                           - функция антидребезговой фильтрации входного сигнала
--
-- Внутренние  : CBF2_calculate_coeff 				- локальная функция раcчета ненормированных коэффициентов фильтра
-- функции   	 									  Чебышева-Баттерворта второго порядка
-- библиотеки    CBFn_calculate_coeff 				- локальная функция расчета (объединения) ненормированных коэффициентов
--				 									  фильтра Чебышева-Баттерворта порядка n
--				 CheckOrder 						- локальная функция проверки корректности ввода порядка фильтра n.
--				 									  (n четное и принадлежит [2:MAX_ORDER])
--				 Calculate_out_offset				- локальная функция расчета смещения выходного сигнала при его
--				 	 	 	 	 	 	 	 	 	  выводе на ЦАП
--
--
-- Как		   : 1) Создать 2 структуры типа Filtering_Options и Filter_Parameters, содержащих соответственно задаваемые
-- использовать 	пользователем параметры фильтрации (тип фильтра, порядок, частоты среза, частоту дискретизации и т.д )
-- (см примеры)		и параметры фильтра - его коэффициенты. (например, в main(),  глобальной области и т.п.)
--				 2) Проинициализировать структуру типа Filtering_Options (при желании можно вручную задать параметры
--					фильтра путем инициализации структуры типа Filter_Parameters)
--				 3) Однократно (каждый раз при необходимости пересчета) вызвать функцию для рассчета коэффициентов
--				 	фильтра Calculate_coef. Также можно добавить постоянное смещение (в вольтах) при помощи функции
--					Calculate_out_offset и/или объединить рассчитанные фильтры последовательно или параллельно при
--					помощи функции Merge_filters
--				 4) В бесконечном цикле (while(1), прерываниях по таймерам и т.п) вызывать функцию фильтрации входного
--					сигнала Filter_sig
--
--
-- Литература  : Стивен Смит. Цифровая обработка сигналов. Практическое руководство для инженеров и научных работников
--				 	- Алгоритм Чебышева-Баттерворта для фильтра 2 порядка (ф-ции CBF2_calculate_coeff, CBFn_calculate_coeff,
--				 	  LowPassFilter_calculate_coef, HighPassFilter_calculate_coef) - гл 33.6, стр 685
--				 	- Расчет режекторного узкополосного фильтра 2 порядка (ф-ция NBRF_calculate_coeff) - гл 19.3, стр 369
--				 	- Алгоритм объединения фильтров (ф-ция Merge_filters) - гл 33.3, стр 677
--					- Алгоритм фильтрации (ф-ция Filter_sig) - гл 19.1, стр 362
--					- Расчет режекторного и полосового фильтров порядка n (ф-ции BandPassFilter_calculate_coef,
--					  BandRejectFilter_calculate_coef) - гл 14.5, стр 310
--				 ПИД-регуляторы - https://chipenable.ru/index.php/item/95 ; https://fast-project.ru/articles/nastrojka-pid.html ;
				 https://alexgyver.ru/lessons/pid/?ysclid=m794ar7am0639265170
				 Преобразования Парка и Кларка https://habr.com/ru/companies/npf_vektor/articles/367653/
---------------------------------------------------------------------------------------------------------------------
--
-- v -.- (18.11.2024)  - добавлен узкополосный рекурсивный фильтр (NBRF) (19.3)
-- v -.- (18.11.2024)  - добавлен Режекторный оконный фильтр (WSRF)
-- v 1.1 (17.12.2024)  - добавлены структуры данных для хранения параметров фильтрации и коэффициентов фильтра, переписаны функции
-- v 2.0 (28.12.2024)  - добавлены Low-pass и High-pass фильтры Чебышева-Баттерворта, реализована математика для алгоритма рассчета Чебышева-Баттерворта
-- v 3.0 (31.01.2025)  - добавлена функция объединения фильтров Merge_filters, добавлены режекторный и полосовой
--						 фильтры. Добавлена функция Calculate_coef для удобного выбора типа фильтров
-- v 3.1 (04.02.2025)  - исправлена ошиба в функции Filter_sig (тип uint обрезал часть значений), добавлена функция
--					 	 смещения выходного сигнала для его корректного отображения при помощи ЦАП (актуально для
--					 	 high-pass фильтра, который убирает постоянную составляющую, из-за чего появляются отрицательные отсчеты)
-- v 4.0 (17.02.2025)  - добавлено подробное описание библиотеки, пример использования и блок-схемы алгоритма работы.
--						 Расчет смещения добавлен в функцию Calculate_coef
-- v 5.0 (19.02.2025)  - добавлен ПИД-регулятор, функции преобразования звезда-треугольник
-- v 6.0 (25.02.2025)  - добавлены функции прямого и обратного преобразований Парка и Кларка, вычисления текущего среднего
--						 и действующего значений, динамический ограничитель скорости изменения сигнала и антидребезговая
--						 фильтрация
-- v 6.1 (04.03.2025)  - добавлена функция RMS для вычисления среднеквадратичного значения произвольного сигнала, улучшено
--						 описание функций, изменен алгоритм антидребезговой фильтрации, исправлены логические ошибки.
-- v 6.2 (18.03.2025)  - добавлена функция PPC фазо-импульсного преобразования
-- v 6.3 (22.07.2025)  - изменен тип данных функции Filter_sig и входного/выходного буферов структруры Filter_Parameters
--                       int32_t -> float в связи с некорректной фильтрацией небольших колебаний около постоянного уровня,
--                       когда из-за малости входных коэффициентов (для ФНЧ с низкой относительной частотой отсечки)
--                       результат выхода округлялся до целого и не менялся, в результате вход никак не влиял на выход.
-- v 6.4 (28.07.2025)  - добавлен узкополосный полоснопропускной фильтр (NBPF) (19.3)
-- v 6.5 (07.08.2025)  - переработаны структуры данных для фильтров. Единая структура Filter_Parameters разделена на две-
--                       Filter_Coefficients с неизменными коэффициентами фильтра, а также Filter_Buffers, хранящую предыдущие
--                       входные и выходные отсчеты. Структура Filtering_Options переименована в Filter_Parameters.
-- v 6.6 (26.08.2025)  - добавлена функция побитовой фильтрации входной величины uint32_t с заданной маской. Функция объявлена
--                       в .h файле как встраиваемая с аттрибутом __attribute__((always_inline))
-- v 6.7 (30.10.2025)  - модифицирована функция вычисления среднеквадратичного значения RMS. Добавлена функция сброса ошибки
--                       при вычислении среднеквадратичного значения RMS_rst_err. Добавлена функция вычисления среднеквадратичного
--                       значения для сигналов типа float
---------------------------------------------------------------------------------------------------------------------
//TODO проверить код из примера
 	 	 	 	 	 	 	 	 	 	 	 Пример использования:

#include "DSPlib.h"

int main(void){


	uint in_sig, out_sig								//Неотфильтрованный (например, с АЦП) и отфильтрованный (выводимый на ЦАП) сигнал

	Filter_Parameters Fil_Par1, Fil_Par2, Fil_Par_Merged;

	Filtering_Options Fil_Opt1 = { 	BAND_REJECT,		//Тип фильтра. Возможные варианты указаны в .h - файле
									2,					//Порядок фильтра
									1000,				//Нижняя частота среза (именно ее надо задавать для ФНЧ, верхняя не влияет)
									5000,				//Верхняя частота среза (именно ее надо задавать для ФВЧ, нижняя не влияет)
									20000,				//Частота дискретизации
									5,					//Размах колебаний АЧХ в процентах
									0,					//Ширина переходной зоны (используется только режекторным узкополосным фильтром)
									1.5					//Величина постоянного смещения выходного сигнала в вольтах
								 };						//при выводе его на 12-битный ЦАП

	Filtering_Options Fil_Opt2 = { 	LOW_PASS,			//Тип фильтра. Возможные варианты указаны в .h - файле
									4,					//Порядок фильтра
									2000,				//Нижняя частота среза (именно ее надо задавать для ФНЧ, верхняя не влияет)
									0,					//Верхняя частота среза (именно ее надо задавать для ФВЧ, нижняя не влияет)
									20000,				//Частота дискретизации
									0,					//Размах колебаний АЧХ в процентах
									0,					//Ширина переходной зоны (используется только режекторным узкополосным фильтром)
									0					//Величина постоянного смещения выходного сигнала в вольтах
								 };						//при выводе его на 12-битный ЦАП


	Fil_Par1 = Calculate_coef(&Fil_Opt1);
	Fil_Par2 = Calculate_coef(&Fil_Opt2);

	Fil_Par_Merged = Merge_filters(Fil_Par1, Fil_Par2, SERIAL);

	while(1){
		out_sig	= Filter_sig(in_sig, &Fil_Par_Merged );
	}
}

---------------------------------------------------------------------------------------------------------------------
*/

#include "DSPlib.h"
#include "string.h"

//Определение для ограничения значения сверху и снизу.
#define Constrain(val, Min_val, Max_val)   ( ((val) < (Min_val)) ? (Min_val) : ( ((val) > (Max_val)) ? (Max_val) : (val) ) );

//Локальные вспомогательные функции для рассчета фильтров
static Filter_Coefficients CBF2_calculate_coeff(Filter_Parameters *CBF2_par, uint8_t Pol_Num, uint8_t Filter_Type);
static Filter_Coefficients CBFn_calculate_coeff(Filter_Parameters *CBFn_par, uint8_t Filter_Type);
static void CheckOrder(Filter_Parameters *par, uint8_t max_order);
//static int32_t Calculate_out_offset(Filter_Parameters *par);

/************************************************************************************************************************/
/*							Режекторный узкополосный фильтр(Narrow-Band Rejection Filter)								*/
/************************************************************************************************************************/

/**
  * @brief  Раcчет коэффициентов режекторного узкополосного фильтра 2 порядка (NBRF - narrow-band rejection filter)(19.3 стр 370)
  *
  *	@param	Filtering_Options		-- Структура, содержащая параметры фильтрации - нижнюю и верхнюю границы
  * 								   полосы пропускания/отсечки, ширину переходной зоны и частоту дискретизации
  * @retval Filter_Parameters		-- Структура, содержащая параметры фильтра - весовые коэффициенты,
  * 								   порядок изначения прошлых входных и выходных сигналов.
  *
  *             АЧХ
  *
  *           BW
  *	  |     |<-->|
  *	  |_____.    .     ______
  *	 a|		\    .    /
  *	 m|		 \   .   /
  *	 p| 	  \  .  /
  *	  |        \ . /
  *   |_________\./___________
  *			   rej_f			freq
  *
  */
Filter_Coefficients NBRF_calculate_coef(Filter_Parameters *par){ //Передаем по адресу, так как хотим менять значения. Поэтому оператор ->
	Filter_Coefficients coef = {0};	//А здесь уже локальная структура, потому операция .

	double rej_f = (par->High_Freq == 0) ? par->Low_Freq : par->High_Freq; //Задаем любую одну, либо обе
	double disc_f = par->Sampling_Freq;
	double BW = par->Band_Width;

	double f = rej_f/disc_f;							//относительная частота фильтруемой гармоники
	double bw = BW/disc_f;
	double R = 1 - 3*bw;
	double K = (1 - 2*R*cos(2*PI*f) + R*R) / (2 - 2*cos(2*PI*f));



	coef.In_Coef[0] = K;  						//A0
	coef.In_Coef[1] = -2*K*cos(2*PI*f);			//A1
	coef.In_Coef[2] = K;							//A2
	coef.Out_Coef[0] = 1;						//B0
	coef.Out_Coef[1] = 2*R*cos(2*PI*f);			//B1
	coef.Out_Coef[2] = - R*R;					//B2
	coef.Order = 2;
	return coef;
}




/************************************************************************************************************************/
/*                               Полосовой узкополосный фильтр(Narrow-Band Pass Filter)                                 */
/************************************************************************************************************************/

/**
  * @brief  Раcчет коэффициентов полосового узкополосного фильтра 2 порядка (NBPF - narrow-band pass filter)(19.3 стр 370)
  *
  *	@param	Filtering_Options		-- Структура, содержащая параметры фильтрации - нижнюю и верхнюю границы
  * 								   полосы пропускания/отсечки, ширину переходной зоны и частоту дискретизации
  * @retval Filter_Parameters		-- Структура, содержащая параметры фильтра - весовые коэффициенты,
  * 								   порядок изначения прошлых входных и выходных сигналов.
  *
  *             АЧХ
  *
  *          BW
  *   |    |<--->|
  *   |    .     .
  *  a|    .    /.\
  *  m|    .   / . \
  *  p|    .  /  .  \
  *   |    . /   .   \
  *   |____./____.____\________
  *			 pass_f			freq
  *
  */
Filter_Coefficients NBPF_calculate_coef(Filter_Parameters *par){ //Передаем по адресу, так как хотим менять значения. Поэтому оператор ->
	Filter_Coefficients coef = {0};	//А здесь уже локальная структура, потому операция .

	double pass_f = (par->High_Freq == 0) ? par->Low_Freq : par->High_Freq; //Задаем любую одну, либо обе
	double disc_f = par->Sampling_Freq;
	double BW = par->Band_Width;

	double f = pass_f/disc_f;							//относительная частота фильтруемой гармоники
	double bw = BW/disc_f;
	double R = 1 - 3*bw;
	double K = (1 - 2*R*cos(2*PI*f) + R*R) / (2 - 2*cos(2*PI*f));



	coef.In_Coef[0] = 1-K;  						//A0
	coef.In_Coef[1] = 2*(K-R)*cos(2*PI*f);		//A1
	coef.In_Coef[2] = R*R-K;						//A2
	coef.Out_Coef[0] = 1;						//B0
	coef.Out_Coef[1] = 2*R*cos(2*PI*f);			//B1
	coef.Out_Coef[2] = - R*R;					//B2
	coef.Order = 2;
	return coef;
}




/************************************************************************************************************************/
/*							Фильтры, рассчитанные по алгоритму Чебышева-Баттерворта     								*/
/************************************************************************************************************************/

/**
  * @brief  Функция окончательного расчета (нормирования) коэффициентов Low-Pass фильтра Чебышева-Баттерворта
  * 		порядка n (n КРАТНО 2!!)
  *
  *	@param	Filtering_Options		-- Структура, содержащая параметры фильтрации - нижнюю и верхнюю границы
  * 								   полосы пропускания/отсечки, ширину переходной зоны и частоту дискретизации
  * @retval Filter_Parameters		-- Структура, содержащая параметры фильтра - весовые коэффициенты,
  * 								   порядок и значения прошлых входных и выходных сигналов. Возвращает
  * 								   НОРМИРОВАННЫЕ коэффициенты фильтра порядка n.
  *
  *	   		           АЧХ
  *	  |
  *	  |_____
  *	 a|		\
  *	 m|		 \
  *	 p| 	  \
  *   |        \
  *   |_________\.___________________
  *			Low_Freq                freq
  *
  */
Filter_Coefficients LowPassFilter_calculate_coef(Filter_Parameters *par){
/*
//Проверяем, что введенный порядок больше 0
	par->Order = (par->Order > 0) ? par->Order : 2;
//Проверяем, что введенный порядок четный
	par->Order = (par->Order % 2 == 0) ? par->Order : par->Order + 1;
//Проверяем, что введенный порядок не превышает максимальный порядок MAX_ORDER
	par->Order = (par->Order <= MAX_ORDER) ? par->Order : MAX_ORDER;
*/
//Проверяем, что введенный порядок фильтра четный и принадлежит от 2 до MAX_ORDER
	CheckOrder(par, MAX_ORDER);
	Filter_Coefficients coef = CBFn_calculate_coeff(par, LOW_PASS);
//Нормируем полученные коэффициенты (своя нормировка для каждого типа фильтра)
	double In_Coef_Sum = 0;
	double Out_Coef_Sum = 1;   //1, так как Out_Coef[0] = -1, а в рассчетах его не учитывают
		for(int i = 0; i <= par->Order ; i++){
//		for(int i = 0; i <= MAX_ORDER ; i++){
			In_Coef_Sum += coef.In_Coef[i];
			Out_Coef_Sum += coef.Out_Coef[i];
		}
	double norm_mul = In_Coef_Sum / (1 - Out_Coef_Sum);

	for(int i = 0; i <= par->Order; i++){
//	for(int i = 0; i <= MAX_ORDER; i++){
		coef.In_Coef[i] /= norm_mul;
	}
	coef.Order = par->Order;		//Указываем порядок фильтра в Filter_Parameters для расчета отфильтрованных значений в функции Filter_sig
	return coef;
}

//TODO определить, необходимо ли править G до равенства нулю их суммы


/**
  * @brief  Функция окончательного расчета (нормирования) коэффициентов High-Pass фильтра Чебышева-Баттерворта
  * 		порядка n (n КРАТНО 2!!)
  *
  *	@param	Filtering_Options		-- Структура, содержащая параметры фильтрации - нижнюю и верхнюю границы
  * 								   полосы пропускания/отсечки, ширину переходной зоны и частоту дискретизации
  * @retval Filter_Parameters		-- Структура, содержащая параметры фильтра - весовые коэффициенты,
  * 								   порядок и значения прошлых входных и выходных сигналов. Возвращает
  * 								   НОРМИРОВАННЫЕ коэффициенты фильтра порядка n.
  *
  *	   		         АЧХ
  *	  |
  *	  | 	 	              ______
  *	 a|			             /
  *	 m|		 	 	        /
  *	 p| 	  	           /
  *   |             	  /
  *   |_________________./___________
  *			           High_Freq     freq
  *
  */
Filter_Coefficients HighPassFilter_calculate_coef(Filter_Parameters *par){
//Проверяем, что введенный порядок фильтра четный и принадлежит от 2 до MAX_ORDER
	CheckOrder(par, MAX_ORDER);
	Filter_Coefficients coef = CBFn_calculate_coeff(par, HIGH_PASS);
//Нормируем полученные коэффициенты (своя нормировка для каждого типа фильтра)
	double In_Coef_Sum = 0;
	double Out_Coef_Sum = 1;   //1, так как Out_Coef[0] = -1, а в рассчетах его не учитывают
		for(int i = 0; i <= par->Order ; i++){
			In_Coef_Sum += coef.In_Coef[i] * pow(-1,i);
			Out_Coef_Sum += coef.Out_Coef[i] * pow(-1,i);
		}
	double mul = In_Coef_Sum / (1 - Out_Coef_Sum);
	for(int i = 0; i <= par->Order; i++){
		coef.In_Coef[i] /= mul;
	}
	coef.Order = par->Order;
	return coef;
}




/**
  * @brief  Функция расчета коэффициентов полосового фильтра Чебышева-Баттерворта порядка n
  * 		(n четное, n принадлежит [2:MAX_ORDER]).Образован последовательным включением фильтра верхней и
  * 		фильтра нижней частоты, каждый порядка n/2
  *
  *	@param	Filtering_Options		-- Структура, содержащая параметры фильтрации - нижнюю и верхнюю границы
  * 								   полосы пропускания/отсечки, ширину переходной зоны и частоту дискретизации
  * @retval Filter_Parameters		-- Структура, содержащая параметры фильтра - весовые коэффициенты,
  * 								   порядок и значения прошлых входных и выходных сигналов. Возвращает
  * 								   НОРМИРОВАННЫЕ коэффициенты фильтра порядка n.
  *
  *	   		        АЧХ
  *	  |
  *	  |            _____
  *	 a|           /     \
  *	 m|          /       \
  *	 p|         /         \
  *   |        /           \
  *   |______./_____________\._________
  *		 Low_Freq        High_Freq   freq
  *
  */
Filter_Coefficients BandPassFilter_calculate_coef(Filter_Parameters *par){
//Проверяем, что введенный порядок фильтра четный и принадлежит от 2 до MAX_ORDER/2
	CheckOrder(par, MAX_ORDER/2);

//Т.к. High_Freq используется при расчете HighPassFilter, а Low_Freq - для LowPassFilter, но при рассчете
//полосового фильтра методом последовательного включения фильтра верхних и нижних частот нужно поменять
//частоты местами, иначе результирующий фильтр ничего не будет пропускать. Потому вводим промежуточную
//структуру temp
	Filter_Parameters temp = *par;
	temp.High_Freq = par->Low_Freq;
	temp.Low_Freq = par->High_Freq;
	temp.Order =  par->Order;
//Включаем LPF и HPF последовательно
	Filter_Coefficients coef = Merge_filters(LowPassFilter_calculate_coef(&temp), HighPassFilter_calculate_coef(&temp), SERIAL);

//TODO поправить этот косяк, написать фильтр 1 порядка.иначе все совсем некрасиво получается(см комментарий к строке ниже)

 //необходимо, так как функция LowPassFilter_calculate_coef может изменить порядок, если он будет нечетным. Например, если порядок фильтра 6, то он образован из 2 фильтров 3 порядка. но функция умеет считатьь лишь четые порядки, то есть 2 раза округлит до 4. в итоге на выходе будет 8 порядок
	return coef;
}




/**
  * @brief  Функция расчета режекторного фильтра Чебышева-Баттерворта порядка n
  * 		(n четное, n принадлежит [2:MAX_ORDER]). Образован параллельным включением фильтра верхней и
  * 		фильтра нижней частоты, каждый порядка n/2
  *
  *	@param	Filtering_Options		-- Структура, содержащая параметры фильтрации - нижнюю и верхнюю границы
  * 								   полосы пропускания/отсечки, ширину переходной зоны и частоту дискретизации
  * @retval Filter_Parameters		-- Структура, содержащая параметры фильтра - весовые коэффициенты,
  * 								   порядок и значения прошлых входных и выходных сигналов. Возвращает
  * 								   НОРМИРОВАННЫЕ коэффициенты фильтра порядка n.
  *
  *	   		        АЧХ
  *	  |
  *	  |_____	 	            ______
  *	 a|		\	               /
  *	 m|		 \	 	          /
  *	 p| 	  \	             /
  *   |        \      	    /
  *   |_________\.________./___________
  *			Low_Freq   High_Freq     freq
  *
  */
Filter_Coefficients BandRejectFilter_calculate_coef(Filter_Parameters *par){
//Проверяем, что введенный порядок фильтра четный и принадлежит от 2 до MAX_ORDER/2
	CheckOrder(par, MAX_ORDER/2);

//Вводим промежуточную структуру temp, чтобы не изменять порядок фильтра в основной структуре
	Filter_Parameters temp = *par;

//Включаем LPF и HPF параллельно
	Filter_Coefficients coef = Merge_filters(LowPassFilter_calculate_coef(&temp), HighPassFilter_calculate_coef(&temp), PARALLEL);

	return coef;
}




/**
  * @brief  Функция расчета коэффициентов фильтра выбранного типа
  *
  *	@param	Filtering_Options		-- Структура, содержащая параметры фильтрации - нижнюю и верхнюю границы
  * 								   полосы пропускания/отсечки, ширину переходной зоны и частоту дискретизации
  *
  * @note   Обратите внимание, что при неверно указанном параметре Type структуры Fil_Opt будут рассчитаны коэффициенты
  * 		Low-Pass фильтра. Сам параметр Type может принимать значения в соответствии с таблицей:
  *									   ТИП 				КОД 	СОКРАЩЕНИЕ
  *									   -----------------------------------
  * 								   NARROW_BAND		0		NB
  * 								   LOW_PASS			1		LP
  * 								   HIGH_PASS		2		HP
  * 								   BAND_PASS		3		BP
  * 								   BAND_REJECT		4		BR
  *
  * @retval Filter_Parameters		-- Структура, содержащая параметры фильтра - весовые коэффициенты,
  * 								   порядок и значения прошлых входных и выходных сигналов. Возвращает
  * 								   НОРМИРОВАННЫЕ коэффициенты фильтра порядка n.
  */
Filter_Coefficients Calculate_fil_coef(Filter_Parameters *par){
	Filter_Coefficients coef;
	switch (par->Type ){

		case NARROW_BAND_REJECT:
			coef = NBRF_calculate_coef(par);
			break;

		case NARROW_BAND_PASS:
			coef = NBPF_calculate_coef(par);
			break;

		case LOW_PASS:
			coef = LowPassFilter_calculate_coef(par);
			break;

		case HIGH_PASS:
			coef = HighPassFilter_calculate_coef(par);
			break;

		case BAND_PASS:
			coef = BandPassFilter_calculate_coef(par);
			break;

		case BAND_REJECT:
			coef = BandRejectFilter_calculate_coef(par);
			break;

		default :
			par->Type = LOW_PASS;
			coef = LowPassFilter_calculate_coef(par);

	}
//	coef.Out_Offset = Calculate_out_offset(par);
	return coef;
}




/**
  * @brief  Функция для объединения коэффициентов 2 фильтров при параллельном или последовательном включении (стр 677-681)
  *
  *	@note   Функция не контроллирует входные порядки фильтров, чтобы не было переполнения контроллируется только
  *			выход за максимальный порядок MAX_ORDER. Так что корректный результат будет только в том случае,
  *			если сумма порядков входных фильтров не больше MAX_ORDER
  *
  *	@note   Обратите внимание, что параллельное соединение возможно только для фильтров одинакового порядка!!!
  *
  *	@param	coef1					-- Структура, содержащая параметры фильтра 1
  *	@param	coef2						-- Структура, содержащая параметры фильтра 2
  * @param	connection_type			-- Тип включения фильтров. SERIAL(0) - последовательное, PARALLEL(1) - параллельное
  * @retval Filter_Parameters		-- Структура, содержащая весовые коэффициенты результирующего фильтра.
  */
Filter_Coefficients Merge_filters(Filter_Coefficients coef1, Filter_Coefficients coef2, uint8_t connection_type){
	Filter_Coefficients merged_coef = {0};

//Проверяем, что при параллельном соединении порядки одинаковы. В противном случае приравниваем (до наименьшего порядка)
	if((connection_type == PARALLEL)&&(coef1.Order < coef2.Order)){
		coef2.Order = coef1.Order;
	}
	else if ((connection_type == PARALLEL)&&(coef2.Order < coef1.Order)){
		coef1.Order = coef2.Order;
	}

//Проверяем, не превосходт ли суммарный порядок нового фильтра максимальный допустимый порядок MAX_ORDER.
//Если превосходит, то выводим 0 в качестве порядка результирующего фильтра - так как вычисления все равно не
//будут верны из-за переполнения массива с результирующими коэффициентами
	int sum_order = (coef1.Order+coef2.Order <= MAX_ORDER) ? coef1.Order+coef2.Order : 0;

//Переходим от коэффициентов к передаточной функции (Т.к умножать мы можем только передаточные функции)(домножаем на -1 коэффициенты знаменателя передаточной функции (Out_Coef) )
	for(int i = 0; i <= sum_order; i++){
		coef1.Out_Coef[i] = - coef1.Out_Coef[i];
		coef2.Out_Coef[i] = - coef2.Out_Coef[i];
	}
	coef1.Out_Coef[0] = 1;
	coef2.Out_Coef[0] = 1;

//Умножение полиномов с использованием свертки
	for(int i = 0; i <= sum_order; i++){
		merged_coef.In_Coef[i] = 0;
		merged_coef.Out_Coef[i] = 0;
		for(int j = 0; j <= coef1.Order; j++){
			if( (i-j < 0) || (i-j > coef2.Order)){		//делаем проверку выхода за пределы массива (чтобы не дополнять нулями массив коэффициентов фильтра 1 для корректной свёртки с фильтром 2 - см рисунок 6.9 стр 146)
				continue;
			}
//Сворачиваем входные коэффициенты фильтра 1 с входными коэффициентами фильтра 2 в новый фильтр с числом
//коэффициентов N1+N2-1. Фильтры соединены последовательно
			if(connection_type == SERIAL){
				merged_coef.In_Coef[i] += coef1.In_Coef[j] * coef2.In_Coef[i-j];
			}
//Сворачиваем входные коэффициенты фильтра 1 с входными и выходными коэффициентами фильтра 2 в новый фильтр
//с числом коэффициентов 2N-1 (N1 должно быть равно N2!!, иначе в вычислениях могут быть учтены несуществующие
//коэффициенты coef1.Out_Coef[i-j], так как i-j > coef2.Order и определяется порядком второго фильтра). Фильтры соединены параллельно
			else if(connection_type == PARALLEL){
				merged_coef.In_Coef[i] += coef1.In_Coef[j] * coef2.Out_Coef[i-j] + coef2.In_Coef[j] * coef1.Out_Coef[i-j];
			}
//Сворачиваем выходные коэффициенты фильтров
			merged_coef.Out_Coef[i] += coef1.Out_Coef[j] * coef2.Out_Coef[i-j];
		}
	}

//Переходим от передаточной функции к коэффициентам  (домножаем на -1 коэффициенты знаменателя передаточной функции (Out_Coef) )
	for(int i = 0; i <= sum_order; i++){
		merged_coef.Out_Coef[i] = - merged_coef.Out_Coef[i];
	}
	merged_coef.Out_Coef[0] = -1;
	merged_coef.Order = sum_order;
	return merged_coef;
}




/**
  * @brief  Функция фильтрации входного сигнала (на основе текущего, order предыдущих входных и order выходных
  * 		сигналов, взвешенных с коэффициентами In_Coef(order+1) и Out_Coef(order+1) соответственно)
  *
  * @param  input_sig 		-- Значение входного сигнала
  * @retval output_sig		-- Отфильтрованное значение выходного сигнала
  */
float Filter_sig( float input_sig, const Filter_Coefficients *coef, Filter_Buffers *buf){
//Считаем выходной сигнал, взвешивая текущий и предыдущие входные сигналы с весами In_Coef, а также предыдущие
//выходные сигналы с весами Out_Coef. Заметим, что Out_Coef[0] равен единице и здесь не учитывается, поскольку
//мы еще не знаем текущий выходной сигнал
	double output_sig = input_sig * coef->In_Coef[0];
	for(int i = 1; i <= coef->Order; i++){
		output_sig += buf->In_Buf[i-1] * coef->In_Coef[i] + buf->Out_Buf[i-1] * coef->Out_Coef[i]; //Складываем без приведения типа к uint!!!!
	}
//Сдвиг для вычисления выходного сигнала на следующей итерации (аналогично FILO - First Input Last Output)
	for(int i = coef->Order - 1; i > 0; i--){
		buf->In_Buf[i] = buf->In_Buf[i-1];
		buf->Out_Buf[i] = buf->Out_Buf[i-1];
	}
	buf->In_Buf[0] = input_sig;
//	buf->Out_Buf[0] = (int32_t)output_sig;
	buf->Out_Buf[0] = output_sig;

	return output_sig; //+ coef.Out_Offset; //Добавляем смещение. Конечно, можно прямо здесь рассчитать, но это снизит быстродействие
}




/**
  * @brief  Локальная функция раcчета ненормированных коэффициентов фильтра Чебышева-Баттерворта
  * 		второго порядка (CBF2 -  Chebyshev-Butterworth Filter order 2). Используется локально (только внутри
  * 		библиотеки) для расчетов нормированных коэффициентов в функции CBFn_calculate_coeff (здесь математическая часть)
  * 		Подробнее - П 33.6.3 стр 686 книги Цифровая_обработка_сигналов_Практическое_руководство_для_инженеров
  *
  *	@param	Filtering_Options		-- Структура, содержащая параметры фильтрации - нижнюю и верхнюю границы
  * 								   полосы пропускания/отсечки, ширину переходной зоны и частоту дискретизации
  * @param	Pol_Num					-- Переменная для локального обмена информацией между функциями CBF2_calculate_coeff
  * 								   и CBFn_calculate_coeff.Счетчик количества вызовов функции CBF2_calculate_coeff
  * 								   функцией CBFn_calculate_coeff. Необходим для корректного обсчета и расположения
  * 								   полюсов на единичной окружности
  * @param	Filter_Type				-- Тип фильтра. Возможны 2 варианта - LOW_PASS и HIGH_PASS;
  * @retval Filter_Parameters		-- Структура, содержащая параметры фильтра - весовые коэффициенты,
  * 								   порядок и значения прошлых входных и выходных сигналов. Возвращает
  * 								   НЕНОРМИРОВАННЫЕ коэффициенты фильтра второго порядка.
  */
static Filter_Coefficients CBF2_calculate_coeff(Filter_Parameters *CBF2_par, uint8_t Pol_Num, uint8_t Filter_Type){
	Filter_Coefficients CBF2_coef = {0};
	CBF2_par->Order = CBF2_par->Order < 2 ? 2 : CBF2_par->Order;  //Устанавливаем минимальный порядок фильтра 2. Иначе в следующей строке может быть ошибка деления на 0
//Вычисление координат полюса на единичной окружности (второе слагаемое введено для упрщения рассчета, так как
//точки на окружности расположены равномерно	)
//TODO здесь проверка только на LOW_PASS. при других типах фильтра всегда выбирается HIGH_PASS, что не очень хорошо. Хотя это и внутренняя функция
	double F_cut = (Filter_Type == LOW_PASS) ? ((double)CBF2_par->Low_Freq / CBF2_par->Sampling_Freq) \
		   : ((double)CBF2_par->High_Freq / CBF2_par->Sampling_Freq) ;	//Относительная частота дискретизации LPF
	double Re_Pol = -cos( (PI / (2*CBF2_par->Order)) + (Pol_Num - 1) * PI/CBF2_par->Order);
	double Im_Pol = sin( (PI / (2*CBF2_par->Order)) + (Pol_Num - 1) * PI/CBF2_par->Order);


	CBF2_par->Swing_Range = ((CBF2_par->Swing_Range >= 30) || (CBF2_par->Swing_Range < 0)) ? 0 : CBF2_par->Swing_Range; //Устанавливаем диапазон [0;29]
//Преобразование окружности в эллипс для фильтра чебышева с ненулевыми колебаниями в полосе пропускания (Swing_Range)
	if(CBF2_par->Swing_Range != 0){
		double es = sqrt( 10000. / ((100 - CBF2_par->Swing_Range) * (100 - CBF2_par->Swing_Range))  -  1);
		double vx = 1./CBF2_par->Order * log((1/es) + sqrt(1/(es*es)+1));
		double kx = 1./CBF2_par->Order * log((1/es) + sqrt(1/(es*es)-1));
		kx = (exp(kx) + exp(-kx)) / 2;
		Re_Pol = Re_Pol * (exp(vx) - exp(-vx)) / (2*kx);
		Im_Pol = Im_Pol * (exp(vx) + exp(-vx)) / (2*kx);
	}

//Преобразование S-области в Z-область
	double t = 2*tan(0.5);
	double w = 2*PI*F_cut;
	double m = Re_Pol*Re_Pol + Im_Pol*Im_Pol;
	double d = 4 - 4*Re_Pol*t + m*t*t;
	double x0 = t*t / d;
	double x1 = 2*t*t / d;
	double x2 = t*t / d;
	double y1 = (8 - 2*m*t*t) / d;
	double y2 = (-4 - 4*Re_Pol*t - m*t*t) / d;

//Конформное преобразование фильтра с единичной частотой отсечки к фильтру с частотой отсечки F_cut_low
	double k = (Filter_Type == LOW_PASS) ?  (sin(0.5 - w/2) /  sin(0.5 + w/2)) : ( -cos(w/2 + 0.5) / (cos(w/2 - 0.5)));
	d = 1 + y1*k - y2*k*k;
//Возвращаем НЕНОРМИРОВАННЫЕ коэффициенты фильтра второго порядка
	CBF2_coef.In_Coef[0] = (x0 - x1*k + x2*k*k) / d;
	CBF2_coef.In_Coef[1] = (Filter_Type == LOW_PASS) ? (-2*x0*k + x1 + x1*k*k - 2*x2*k) / d : (2*x0*k - x1 - x1*k*k + 2*x2*k) / d;
	CBF2_coef.In_Coef[2] = (x0*k*k - x1*k + x2) / d;
	CBF2_coef.Out_Coef[0] = 1.;
	CBF2_coef.Out_Coef[1] = (Filter_Type == LOW_PASS) ? (2*k + y1 + y1*k*k - 2*y2*k) / d : (-2*k - y1 - y1*k*k + 2*y2*k) / d;
	CBF2_coef.Out_Coef[2] = ( - k*k - y1*k + y2) / d;
	return CBF2_coef;
}




/**
  * @brief  Функция расчета (объединения) ненормированных коэффициентов фильтра Чебышева-Баттерворта порядка n
  * 		(кратного 2) на основе коэффициентов фильтра 2 порядка (расчитанных функцией CBF2_calculate_coeff)
  * 		Подробнее 33.6.1 стр 683 книги Цифровая_обработка_сигналов_Практическое_руководство_для_инженеров
  *
  *	@param	Filtering_Options		-- Структура, содержащая параметры фильтрации - нижнюю и верхнюю границы
  * 								   полосы пропускания/отсечки, ширину переходной зоны и частоту дискретизации
  * @param	Filter_Type				-- Тип фильтра. LPF = 1, HPF = 0;
  * @retval Filter_Parameters		-- Структура, содержащая параметры фильтра - весовые коэффициенты,
  * 								   порядок и значения прошлых входных и выходных сигналов. Возвращает
  * 								   НЕНОРМИРОВАННЫЕ коэффициенты фильтра порядка n.
  */
static Filter_Coefficients CBFn_calculate_coeff(Filter_Parameters *CBFn_par, uint8_t Filter_Type){
	Filter_Coefficients CBFn_coef = {0};
	Filter_Coefficients CBF2_coef_temp = {0};			//Структура для хранения коэффициентов фильтра 2 порядка
//Создаем и заполняем массивы для временного хранения коэффициентов фильтра порядка n. Их на 2 больше, так как объединение
//коэффициентов фильтров 2 порядка в фильтр порядка n заключается в свертке инвертированной импульсной характеристики
//каждого нового фильтра 2 порядка с результатом, хранящимся в массиве In_Coef_. То есть для вычисления начального отсчета
//потребуются -1 и -2 отсчеты, которые в данных массивах имеют индексы 0 и 1 и равны нулю. И еще добавляем единицу, так как
//фильтр n порядка содержит n+1 коэффициент, поэтому в итоге MAX_ORDER+3
	double In_Coef_[MAX_ORDER+3] = {0,0,1};
	double Out_Coef_[MAX_ORDER+3] = {0,0,1};
	double In_Coef_Temp[MAX_ORDER+3] = {0,0,1};
	double Out_Coef_Temp[MAX_ORDER+3]= {0,0,1};


//Цикл для каждой пары полюсов фильтра второго порядка, рассчитываемых в функции CBF2_calculate_coeff
//(заметим, что полюса симметричны относительно действительной оси S-плоскости)
	for(uint8_t p = 1; p <= (CBFn_par->Order)/2; p++){
		CBF2_coef_temp = CBF2_calculate_coeff(CBFn_par, p, Filter_Type);
//Копируем значения коэффициентов во временный буфер
		for(int i = 0; i < MAX_ORDER+3; i++){
			In_Coef_Temp[i] = In_Coef_[i];
			Out_Coef_Temp[i] = Out_Coef_[i];
		}
//TODO здесь можно считать не по всему массиву, а только до order + 3 (наверное)
//Осуществляем свертку значений, сохраненных во временных буферах, с фильтром 2 порядка, записывая результат
//в In_Coef_ и Out_Coef_
		for(int i = 2; i < MAX_ORDER+3; i++){
			In_Coef_[i]	=	CBF2_coef_temp.In_Coef[0]*In_Coef_Temp[i] +
							CBF2_coef_temp.In_Coef[1]*In_Coef_Temp[i-1] +
							CBF2_coef_temp.In_Coef[2]*In_Coef_Temp[i-2];      //Вот здесь видно, зачем нам еще +2 элемента в массиве к исходным MAX_ORDER+1

			Out_Coef_[i]=	Out_Coef_Temp[i] -   							//Т.к. CBF2_coef_temp.Out_Coef[0] = 1;
							CBF2_coef_temp.Out_Coef[1]*Out_Coef_Temp[i-1] -
							CBF2_coef_temp.Out_Coef[2]*Out_Coef_Temp[i-2];
		}
	}

//Окончание объединения коэффициентов.По окончании цикла по перебору полюсов p записываем массивы
//In_Coef_ и Out_Coef_  со сдвигом на 2 индекса, исключая два первых нулевых значения
	for(int i = 0; i < MAX_ORDER+1; i++){
		CBFn_coef.In_Coef[i] = In_Coef_[i+2];
		CBFn_coef.Out_Coef[i] = - Out_Coef_[i+2];
	}
	return CBFn_coef;
}




/**
  * @brief	Функция проверки корректности ввода порядка фильтра n.(n четное и принадлежит [2:MAX_ORDER])
  *
  *	@param	Filtering_Options		-- Структура, содержащая параметры фильтрации - нижнюю и верхнюю границы
  * 								   полосы пропускания/отсечки, ширину переходной зоны и частоту дискретизации
  * @retval none
  */
static void CheckOrder(Filter_Parameters *par, uint8_t max_order){
//Проверяем, не превосходит ли ввведенный нами порядок MAX_ORDER
	max_order = (max_order > MAX_ORDER) ? MAX_ORDER: max_order;
//Проверяем, что введенный порядок больше 0
	par->Order = (par->Order > 0) ? par->Order : 2;
//Проверяем, что введенный порядок четный
	par->Order = (par->Order % 2 == 0) ? par->Order : par->Order + 1;
//Проверяем, что введенный порядок не превышает максимальный порядок MAX_ORDER
	par->Order = (par->Order <= max_order) ? par->Order : max_order;
}




///**
//  * @brief  Функция расчета смещения выходного сигнала.
//  *
//  *	@note   Обратите внимание, что на вход функция принимает значение В ВОЛЬТАХ (из структуры параметров фильтрации),
//  * 		возвращает значение в ЕДИНИЦАХ ШКАЛЫ ЦАП. Разрядность ЦАП задается постоянной DAC_BIT_RATE, объявленной в
//  * 		.h - файле
//  *
//  *	@param	Filtering_Options		-- Структура, содержащая параметры фильтрации, в данной функции используется только
//  *									   Out_Offset, выраженный в вольтах.
//  *
//  * @retval int32_t					-- Значение смещения в единицах шкалы ЦАП битностью DAC_BIT_RATE
//  */
//static int32_t Calculate_out_offset(Filter_Parameters *par){
//	return (int32_t) (par->Out_Offset / HIGH_LOGICAL_LEVEL * (float)pow(2,DAC_BIT_RATE));
//}


//TODO КИХ фильтры не отлажены!!!!!

/************************************************************************************************************************/
/*								Режекторный оконный фильтр(Windowed-Sync Rejection Filter)								*/
/************************************************************************************************************************/
/*
 * 	  Подробнее - см. книгу Стивен Смит: Цифровая обработка сигналов. Практическое руководство для инженеров и научных работников
 * 	  гл 16, стр 325
 *
 * 	   		         АЧХ
 *
 *	  		  BW    win_f
 *	  |		|<-->|<------->|
 *	  |_____	 |	       |     ______
 *	 a|		\	 |         |    /
 *	 m|		 \	 |	       |   /
 *	 p| 	  \	 |         |  /
 *	  |        \ |     	   | /
 *    |_________\_____._____/___________
 *				    rej_f			freq
 */

/*

double LPF_kernel[1000];
double HPF_kernel[1000];
double WSRF_kernel[1000];

void calculate_sinc_kernel(double *cernel, double f, int M){
	double *w = (double*)malloc(M * sizeof(double));
//Считаем ненормированную импульсную характеристику, выделяя случай i = M/2 (возможен лишь когда M%2 == 0)
	if(M%2 == 0){
		for(int i = 0; i < M/2; i++){
			w[i] = 0.54 - 0.46*cos(2*PI*i/M);						//Оконная функция Хэмминга
		//	w[i] = 0.42 - 0.5*cos(2*PI*i/M) + 0.08*cos(4*PI*i/M);	//Оконная функция Блэкмана
			cernel[i] = sin(2*PI*f*(i - M/2))/(i - M/2) * w[i];
		}
		for(int i = M/2+1; i < M; i++){
			w[i] = 0.54 - 0.46*cos(2*PI*i/M);						//Оконная функция Хэмминга
		//	w[i] = 0.42 - 0.5*cos(2*PI*i/M) + 0.08*cos(4*PI*i/M);	//Оконная функция Блэкмана
			cernel[i] = sin(2*PI*f*(i - M/2))/(i - M/2) * w[i];
		}
		cernel[M/2] = 2*PI*f*w[M/2];							//Отдельно считаем случай неопределенности
	}
	else{
		for(int i = 0; i < M/2; i++){
			w[i] = 0.54 - 0.46*cos(2*PI*i/M);						//Оконная функция Хэмминга
		//	w[i] = 0.42 - 0.5*cos(2*PI*i/M) + 0.08*cos(4*PI*i/M);	//Оконная функция Блэкмана
			cernel[i] = sin(2*PI*f*(i - M/2))/(i - M/2) * w[i];
		}
	}

//Далее нормируем эту импульсную характеристику
	double sum = 0;
	for(int i = 0; i < M ; i++){
		sum += cernel[i];
	}
	for(int i = 0; i < M ; i++){
		cernel[i] /= sum;
	}
	free(w);
}

void LPF_calculate_kernel(double cut_f,  double BW, double disc_f){
	double f = cut_f/disc_f;						//Относительная частота среза (cutoff freq)
	double bw = BW/disc_f;									//Относительная ширина переходной зоны фильтра
	int M = 4/bw;											//Оптимальный порядок фильтра
	calculate_sinc_kernel(LPF_kernel, f, M);
}


void HPF_calculate_kernel(double cut_f,  double BW, double disc_f){
	double f = cut_f/disc_f;						//Относительная частота среза (cutoff freq)
	double bw = BW/disc_f;									//Относительная ширина переходной зоны фильтра
	int M = 4/bw;											//Оптимальный порядок фильтра
	calculate_sinc_kernel(HPF_kernel, f, M);
	for(int i = 0; i < M; i++){
		HPF_kernel[i] = - HPF_kernel[i];
	}
	HPF_kernel[M/2] += 1;
}

void WSRF_calculate_kernel(double rej_f, double win_f, double BW, double disc_f){  //calculate kernel (impulse response)
	double l_f = (rej_f - win_f/2)/disc_f;					//Нижняя относительная частота фильтруемой гармоники
	double h_f = (rej_f + win_f/2)/disc_f;					//Верхняя относительная частота фильтруемой гармоники
	double bw = BW/disc_f;									//Относительная ширина переходной зоны фильтра
	int M = 4/bw;											//Оптимальный порядок фильтра

	LPF_calculate_kernel(l_f, BW, disc_f);
	HPF_calculate_kernel(h_f, BW, disc_f);

	for(int i = 0; i < M; i++){
		WSRF_kernel[i] = HPF_kernel[i] + LPF_kernel[i];
	}
}
*/

/************************************************************************************************************************/
/*													ПИД-регулятор														*/
/************************************************************************************************************************/

//TODO возможно, надо ограничить выход пид-регулятора и интегралы, чтобы ошибка не превысила какое-то значение

/**
  * @brief  Функция ПИД-регулирования.
  *
  *	@note   Обратите внимание, что функция должна вызываться периодически с частотой Reg_Freq. Удобнее всего сделать
  *			это при помощи прерывания по таймеру
  *
  * @param	setpoint				-- Значение уставки (желаемого выходного значения регулируемой системы)
  *
  * @param	measured_val			-- Значение фактически измеренного сигнала на выходе из регулируемой системы
  *
  *	@param	PID_Parameters			-- Структура, содержащая коэффициенты ПИД-регулятора, временные значения (накапливаемую
  *									   интегральную и предыдущую дифференциальную ошибки), частоту работы и максимальное
  *									   значение выходного сигнала, ограничивающее интегральную ошибку
  *
  * @retval int32_t					-- Значение с учетом ошибок, подаваемое на вход регулируемой системы (PID out)
  *
  * @note   Обратите внимание, что по умолчанию проверка на максимальное выходное значение отключена
  *
  *
  *                 Принципиальная схема подключения блока ПИД-регулировки
  *
  *  		    Блок ПИД-регулировки
  *           . . . . . . . . . . . . .
  *          :    ___        _______   :          ______________________
  * setpoint :   /   \  err |       |  : PID out |                      | measured_val
  * ---------:--|  -  |-----|  PID  |--:---------| Регулируемая система |---------------
  *          :   \___/      |_______|  :         |______________________|              |
  *          :     |                   :                                               |
  *          :     |___________________:_______________________________________________|
  *           . . . . . . . . . . . . .
  */
int32_t PID_calculate( int32_t setpoint, int32_t measured_val, PID_Parameters *PID_Par){
	int32_t err = setpoint - measured_val;					//Разница уставки и измеренного значения
	float dt = 1. / PID_Par->Reg_Freq;						//Интервал дискретизации
//Считаем интегральную ошибку и накапливаем ее в структуре PID_Par, проверяя, входит ли она в допустимый диапазон значений
//(если эти значения заданы)
//	PID_Par->Integral = PID_Par->Integral + (float)err*dt*PID_Par->Ki;
//	if( PID_Par->Max_Out > PID_Par->Min_Out	)
//		PID_Par->Integral = Constrain(PID_Par->Integral, Min_Out, Max_Out);
	if( (PID_Par->Max_Out != 0) && ((int32_t)PID_Par->Integral >  PID_Par->Max_Out) ){

	}
    else if( (PID_Par->Min_Out != 0) && ((int32_t)PID_Par->Integral <  PID_Par->Min_Out) ){

	}
//TODO здесь интеграл считается методом треугольников, но также можно считать методом трапеций. Скорее всего увеличится точность, а скорость рассчета не сильно поменяется
	else {
		PID_Par->Integral = PID_Par->Integral + (float)err*dt*PID_Par->Ki;
	}
//Считаем дифференциальную ошибку
	float dif = (err - PID_Par->Prev_Err)/dt;
	PID_Par->Prev_Err = err;
//Возвращаем значение с выхода блока ПИД-регулятора (PID out, оно же подается на вход регулируемой системы)
	return (int32_t)( PID_Par->Kp*err +  PID_Par->Integral + PID_Par->Kd*dif );
}
/** Рекомендации по вычислению коэффициентов (Карпов В.Э. ПИД-управление в нестрогом изложении):
  * 1)Kp -- Установим сначала маленькое значение kp. Допустим, колебаний еще нет. Далее увеличиваем это значение в 10 раз,
  * пока не начнутся колебания. Теперь уменьшаем значение коэффициента kp, но не в 10 раз, а в 2 раза. И так до тех
  * пор, пока колебания не прекратятся.
  *
  * 2)Kd -- Значение коэффициента интегральной компоненты ki должно быть мало по сравнению c kp. В качестве начального
  * значения коэффициента ki рекомендуется брать число от 0.0001 до 0.01. Процедура поиска (подбора) коэффициента ki
  * точно такая же, как и kp. Слишком большое значение коэффициента ki также проявляется в появлении колебаний.
  *
  * 3)Ki -- Если мы уверены, что шумы в нашей системе на слишком велики, то можно ввести и дифференциальную компоненту.
  * Для настройки kd установим сначала значение этого коэффициента, равное 0. Далее установим какое-нибудь небольшое
  * значение kp (например, kp =1). Главное, что значение kp должно быть таким, чтобы система при нулевом значении kd
  * не совершала колебаний. Далее установим какое-нибудь небольшое начальное значение kd (например, kd =0.1). Будем
  * увеличивать коэффициент kd до тех пор, пока не станут проявляться ошибочные колебания, вызванные малыми шумами.
  * При этом колебания от слишком большого коэффициента происходят значительно быстрее, чем колебания от недостаточного
  * коэффициента. Рекомендуется устанавливать коэффициент в половину или четверть от того, при котором начинаются
  * колебания от слишком большой его величины.
  *
  * Метод Цинглера-Никольса:
  * 1) Обнуляем все коэффициенты регулятора.
  * 2) Задаем некоторое целевое значение регулируемого параметра (например, температуры).
  * 3) Постепенно начинаем увеличивать пропорциональный коэффициент и следим за реакцией системы. При определенном
  * значении kp возникнут незатухающие колебания регулируемой величины.
  * 4) Фиксируем это значение, а также период колебаний системы.
  * 5) Коэффициенты вычисляем по формулам:
  * 	kp := 0.6 * k0
  * 	ki := 2 * kp / T
  * 	kd = kp * T / 8
  */




/************************************************************************************************************************/
/*										Преобразования Звезда <=> Треугольник											*/
/************************************************************************************************************************/

/**
  * @brief  Функция преобразования звезды в треугольник (https://ru.wikipedia.org/wiki/Преобразование_треугольник-звезда)
  *
  *	@note	При преобразованиях звезда<->треугольник, так как рассчет производится в целых числах, дробная часть
  *			будет полностью отброшена, то есть точность вычислений снижается. При необходимости более точных рассчетов
  *			нужно заменить тип переменных в структурах Star_Res и Triangle_Res с uint32_t на float
  *
  * @param	Star_Res				-- Структура, содержащая параметры резистивных элементов, включенных по схеме "звезда"
  *
  * @retval Triangle_Res			-- Структура, содержащая параметры резистивных элементов, включенных по схеме "треугольник"
  *
  *		         "Звезда"                                  "Треугольник"
  *
  *                 1								             1
  *                _|_                                          / \
  *               |   |                                        /   \
  *               |R1 |                                      _/_   _\_
  *               |_ _|                                    /    / \    \
  *                 |                ____\                /R12 /   \ R13\
  *                 |                _____\              /_ _ /     \ _ _\
  *                 |                ____ /               /             \
  *                 0                    /               /    _______    \
  *               /   \                                 /____|  R23  |____\
  *              /     \                              2      |_______|      3
  *            _/_     _\_
  *          /    /   \    \
  *         / R2 /     \ R3 \
  *        /_ _ /       \ _ _\
  *         /               \
  *        2                 3
  *
  */
Triangle_Res Star_to_Triangle(Star_Res Star){
//Суть преобразования - приравнять сопротивления между попарно взятыми узлами. Далее составляем систему и выражаем
	Triangle_Res Triangle;
	Triangle.R12 = Star.R1 + Star.R2 + ( Star.R1 * Star.R2 )/(Star.R3);
	Triangle.R13 = Star.R1 + Star.R3 + ( Star.R1 * Star.R3 )/(Star.R2);
	Triangle.R23 = Star.R2 + Star.R3 + ( Star.R2 * Star.R3 )/(Star.R1);
	return Triangle;
}




/**
  * @brief  Функция преобразования треугольника в звезду (https://ru.wikipedia.org/wiki/Преобразование_треугольник-звезда)
  *
  * @note	При преобразованиях звезда<->треугольник, так как рассчет производится в целых числах, дробная часть
  *			будет полностью отброшена, то есть точность вычислений снижается. При необходимости более точных рассчетов
  *			нужно заменить тип переменных в структурах Star_Res и Triangle_Res с uint32_t на float
  *
  * @param	Triangle_Res			-- Структура, содержащая параметры резистивных элементов, включенных по схеме "треугольник"
  *
  * @retval Star_Res				-- Структура, содержащая параметры резистивных элементов, включенных по схеме "звезда"
  *
  *		         "Звезда"                                  "Треугольник"
  *
  *                 1								             1
  *                _|_                                          / \
  *               |   |                                        /   \
  *               |R1 |                                      _/_   _\_
  *               |_ _|                                    /    / \    \
  *                 |                 /____               /R12 /   \ R13\
  *                 |                /_____              /_ _ /     \ _ _\
  *                 |                \ ____               /             \
  *                 0                 \                  /    _______    \
  *               /   \                                 /____|  R23  |____\
  *              /     \                              2      |_______|      3
  *            _/_     _\_
  *          /    /   \    \
  *         / R2 /     \ R3 \
  *        /_ _ /       \ _ _\
  *         /               \
  *        2                 3
  *
  */
Star_Res Triangle_to_Star(Triangle_Res Triangle){
	//Суть преобразования - приравнять сопротивления между попарно взятыми узлами. Далее составляем систему и выражаем
	Star_Res Star;
	float Sum = Triangle.R12 + Triangle.R13 + Triangle.R23;
	Star.R1 = (Triangle.R12 * Triangle.R13) / Sum;
	Star.R2 = (Triangle.R12 * Triangle.R23) / Sum;
	Star.R3 = (Triangle.R23 * Triangle.R13) / Sum;
	return Star;
}




/************************************************************************************************************************/
/*								Прямое и обратное преобразования Парка и Кларка											*/
/************************************************************************************************************************/
//https://leventozturk.com/engineering/foc/

/**
  * @brief  Функция прямого преобразования Парка для двухфазных токов (Поворот двумерной системы координат на угол fi,
  * 		чаще всего служит для перехода от неподвижной СК статора электродвигателя к подвижной СК ротора)
  * 		(https://www.matematicus.ru/vysshaya-matematika/analiticheskaya-geometriya-na-ploskosti/povorot-osej-koordinat)
  *
  * @note   Обратите внимание, в разных источниках преобразование Парка рассматривается либо как просто поворот системы координат,
  * 		либо как последовательное применение преобразования Кларка и последующего поворота СК (в матричном виде-
  * 		произведение матрицы поворота на матрицу преобразования Кларка Kp = Kr*Kc). В данном случае преобразование
  * 		Парка - просто поворот двумерной СК на угол fi
  *
  * @param	Init_Coord_Sys			-- Структура, содержащая компоненты двумерного вектора в проекции на исходную
  * 								   (неподвижной) систему координат и угол поворота результирующей системы
  * 								   относительно исходной
  *
  * @retval Res_Coord_Sys			-- Структура, содержащая компоненты того же двумерного вектора, но уже в проекции
  * 								   на повернутую (подвижную) систему координат
  *
  *      Y\    y|
  *        \    |
  *         \ fi|
  *          \<-|
  *           \ |        X
  *            \|________
  *                      x
  *
  */
Res_Coord_Sys Direct_Park_Transform(Init_Coord_Sys Init_CS){
	Res_Coord_Sys Res_CS = {0};
//	float TR_Mtx[2][2] = { 	{cos(Init_CS.fi), sin(Init_CS.fi)},
//							{-sin(Init_CS.fi), cos(Init_CS.fi)}	};
	Res_CS.X = 	 Init_CS.x * cos(Init_CS.fi) + Init_CS.y * sin(Init_CS.fi);
	Res_CS.Y = - Init_CS.x * sin(Init_CS.fi) + Init_CS.y * cos(Init_CS.fi);
	return Res_CS;
}




/**
  * @brief  Функция обратного преобразования Парка для двухфазных токов (Поворот двумерной системы координат на
  * 		угол Fi, чаще всего служит для перехода от подвижной СК ротора электродвигателя к неподвижной СК статора)
  * 		(https://www.matematicus.ru/vysshaya-matematika/analiticheskaya-geometriya-na-ploskosti/povorot-osej-koordinat)
  *
  * @note   Обратите внимание, в разных источниках обратное преобразование Парка рассматривается либо как просто
  * 		поворот системы координат, либо как последовательный поворот СК и применение обратного преобразования Кларка
  * 		(в матричном виде - произведение матрицы обратного преобразования Кларка на матрицу поворота : Kp^-1 =
  * 		(Kr*Kc)^-1 = Kc^-1 * Kr^-1 , где Kc^-1 и Kr^-1 должны быть дополнены до квадратных матриц, либо последовательно
  * 		(слева-направо) перемножены на двумерный вектор-столбец входных данных). В данном случае обратное преобразование
  * 		Парка - просто поворот двумерной СК на угол Fi
  *
  *
  * @param	Res_Coord_Sys			-- Структура, содержащая компоненты двумерного вектора в проекции на повернутую
  * 								   (подвижную) систему координат и угол "обратного" поворота исходной системы
  * 								   относительно результирующей
  *
  * @retval Init_Coord_Sys			-- Структура, содержащая компоненты того же двумерного вектора, но уже в проекции
  * 								   на исходную (неподвижную) систему координат
  *
  *      Y\    y|
  *        \    |
  *         \ fi|
  *          \<-|
  *           \ |        X
  *            \|________
  *                      x
  *
  */
Init_Coord_Sys Reverse_Park_Transform(Res_Coord_Sys Res_CS){
	Init_Coord_Sys Init_CS = {0};
	Init_CS.x = Res_CS.X * cos(Res_CS.Fi) - Res_CS.Y * sin(Res_CS.Fi);
	Init_CS.y = Res_CS.X * sin(Res_CS.Fi) + Res_CS.Y * cos(Res_CS.Fi);
	return Init_CS;
}




/**
  * @brief  Функция прямого преобразования Кларка для мощности в сбалансированной системе Ix+Iy+Iz = 0 (Переход от
  * 		трехфазных токов к двухфазным)
  * 		(Подробный вывод - https://en.wikipedia.org/wiki/Direct-quadrature-zero_transformation, в главе Power-variant form - формулы,
  * 		Также формулы в главе Simplified transformation - https://en.wikipedia.org/wiki/Alpha–beta_transformation,
  * 		Зачем это нужно, а также графический вывод формул - Рис 9 https://habr.com/ru/companies/npf_vektor/articles/367653/)
  *
  * @param	Init_Coord_Sys			-- Структура, содержащая "оси" исходной системы трехфазных токов
  *
  * @retval Res_Coord_Sys			-- Структура, содержащая "оси" результирующей системы двухфазных токов
  *
  *
  *         y\                        Y|
  *           \                        |
  *            \ ________x     =>      |__________X
  *            /
  *           /
  *         z/
  */
Res_Coord_Sys Direct_Clarke_Transform(Init_Coord_Sys CS_3D){
//Simplified transformation - https://en.wikipedia.org/wiki/Alpha–beta_transformation
	Res_Coord_Sys CS_2D;
	CS_2D.X = 	(2./3.) * ( CS_3D.x - 0.5 * CS_3D.y - 0.5 * CS_3D.z ); //из сбалансированности системы Ix+Iy+Iz = 0 следует, что CS_2D.X = CS_3D.x
	CS_2D.Y =  (2./3.) * ( SQRT3/2 * CS_3D.y - SQRT3/2 * CS_3D.z);
	CS_2D.Z = 0;
	return CS_2D;
}




/**
  * @brief  Функция обратного преобразования Кларка для мощности в сбалансированной системе Ix+Iy+Iz = 0 (Переход от
  * 		двухфазных токов к трехфазным)
  * 		(Подробный вывод - https://en.wikipedia.org/wiki/Direct-quadrature-zero_transformation, в главе Power-variant form - формулы,
  * 		Также формулы в главе Simplified transformation - https://en.wikipedia.org/wiki/Alpha–beta_transformation,
  * 		Зачем это нужно, а также графический вывод формул - Рис 9 https://habr.com/ru/companies/npf_vektor/articles/367653/)
  *
  * @param	Res_Coord_Sys			-- Структура, содержащая "оси" системы двухфазных токов
  *
  * @retval Init_Coord_Sys			-- Структура, содержащая "оси" системы трехфазных токов
  *
  *
  *        Y|                         y\
  *         |                           \
  *         |_________X        =>        \ ________x
  *                                      /
  *                                     /
  *                                   z/
  */
Init_Coord_Sys Reverse_Clarke_Transform(Res_Coord_Sys CS_2D){
//Simplified transformation - https://en.wikipedia.org/wiki/Alpha–beta_transformation
	Init_Coord_Sys CS_3D;
	CS_3D.x = CS_2D.X;
	CS_3D.y = - 0.5 * CS_2D.X + SQRT3/2 * CS_2D.Y;
	CS_3D.z = - 0.5 * CS_2D.X - SQRT3/2 * CS_2D.Y;
	return CS_3D;
}




/************************************************************************************************************************/
/*								Вычисление текущего среднего и действующего значений 									*/
/************************************************************************************************************************/

/**
  * @brief  Функция вычисления cкользящего среднего значения
  *
  * @note	Алгоритм аналогичен фильтрации, но с постоянными коэффициентами фильтра 1/pnt_num, и в соответсвие
  * 		с этим упрощением оптимизирован. Располагать данную функцию необходимо там же, где и функцию фильтрации-
  * 		в бесконечном цикле while с проверкой флага обновления данных, прерывании по обновлении данных и т.п.
  *
  *	@note	Количество точек, по которому проводится усреднение, задается параметром AVERAGING_NUM, объявленным в
  *			заголовочном файле
  *
  * @param	input_sig				-- Входной сигнал, который необходимо усреднить. Чаще всего сигнал с АЦП
  *
  *	@param	averaging_num			-- Число значений, по которым проводится усреднение (Но не больше MAX_AVERAGING_NUM)
  *
  *	@param	Rolling_Avg_State		-- Структура, содержащая состояния блока и сохраняемые значения, необходимые для расчета
  *
  * @retval int32_t					-- Выходное скользящее (текущее) среднее значение
  *
  */
int32_t Rolling_Avg(int32_t input_sig, uint16_t averaging_num, Rolling_Avg_State *avg_st){
//Сохраняем предыдущие входные значения, необходимые для вычисления скользящего среднего в In_Buff[]
//Накапливаем сумму входных значений.для оптимизации вычислений не вычисляем накопленную в In_Buff[] сумму каждый
//раз заново, а замещаем последнее оставшееся значение новым входным)
	averaging_num = (averaging_num < MAX_AVERAGING_NUM) ? averaging_num : MAX_AVERAGING_NUM;
	avg_st->_sum += input_sig - avg_st->_In_Buff[averaging_num-1];
//Сдвигаем значения в массиве In_Buff для сохранения нового (самое старое значение, находящееся в конце массива, затирается)
	for(int i = averaging_num-1; i > 0; i--){
		avg_st->_In_Buff[i] = avg_st->_In_Buff[i-1];
	}
	avg_st->_In_Buff[0] = input_sig;
//Раз в RESET_SUM вызовов обнуляем ошибку, накопленную при вычислении sum, просто пересчитывая значения по данным в In_Buff[]

#ifdef RESET_SUM
	avg_st->_callback_num++;
	if(avg_st->_callback_num > RESET_SUM){
		avg_st->_callback_num = 0;
		avg_st->_sum = 0;
		for(int i = 0; i < averaging_num; i++){
			avg_st->_sum += avg_st->_In_Buff[i];
		}
	}
#endif
	return (int32_t)(avg_st->_sum / averaging_num);
}




/**
  * @brief  Функция вычисления cкользящего среднего значения для аргумента типа float
  *
  * @note	Алгоритм аналогичен фильтрации, но с постоянными коэффициентами фильтра 1/pnt_num, и в соответсвие
  * 		с этим упрощением оптимизирован. Располагать данную функцию необходимо там же, где и функцию фильтрации-
  * 		в бесконечном цикле while с проверкой флага обновления данных, прерывании по обновлении данных и т.п.
  *
  *	@note	Количество точек, по которому проводится усреднение, задается параметром AVERAGING_NUM, объявленным в
  *			заголовочном файле
  *
  * @param	input_sig				-- Входной сигнал, который необходимо усреднить. Чаще всего нормированный сигнал с АЦП
  *
  *	@param	averaging_num			-- Число значений, по которым проводится усреднение (Но не больше MAX_AVERAGING_NUM)
  *
  *	@param	Rolling_Avg_Param		-- Структура, содержащая параметры блока и сохраняемые значения, необходимые для расчета
  *
  * @retval int32_t					-- Выходное скользящее (текущее) среднее значение
  *
  */
float Rolling_Avg_f(float input_sig, uint16_t averaging_num, Rolling_Avg_Statef *avg_st){
//Сохраняем предыдущие входные значения, необходимые для вычисления скользящего среднего в In_Buff[]
//Накапливаем сумму входных значений.для оптимизации вычислений не вычисляем накопленную в In_Buff[] сумму каждый
//раз заново, а замещаем последнее оставшееся значение новым входным)
#ifdef USE_MALLOC_TO_ALLOCATE_ARRAYS_MEMORY

#else
	averaging_num = (averaging_num < MAX_AVERAGING_NUM) ? averaging_num : MAX_AVERAGING_NUM;
#endif
	int n = avg_st->_n;

//Обнуляем счетчик вызовов функции, тем самым обновляя индексацию циклического буфера с прошлыми измерениями
	if(n == averaging_num){
		avg_st->_n = 0;
		n = 0;
	}
//Прибавляем новое значение и вычитаем старое, находящееся в буфере по индексу n.
	avg_st->_sum = avg_st->_sum + input_sig - avg_st->_In_Buff[n];
/*После того, как мы использовали старое значение, можем его затереть новым. При этом мы постепенно двигаемся
по массиву и затираем старые значения новыми, а по достижении конца переходим в начало, тем самым
мы можем не смещать все элементы массива, как это было сделано ранее. результат в обоих случаях одинаковый.
Только в раннем варианте новое значение мы добавляли строго в начало массива, тем самым смещая все старые,
а здесь новое значение является головой буфера и само перемещается, а справа от него находится хвост,
тем самым мы как бы движемся по кольцу
Классический случай: {[head]..........[tail]} -> {[head+1][head]..........[tail+1]}  [tail] затерли сдвигом всех элементов}
Кольцевой буфер:     {.......[head][tail]...} -> {........[head][head+1][tail+1]..}  [tail] затерли не сдвигом, а [head+1]}*/
	avg_st->_In_Buff[n] = input_sig;
//Увеличиваем индекс, тем самым при следующей итерации будем замещать следующее значение в буфере
	(avg_st->_n) ++;
	return avg_st->_sum / (float)averaging_num;
}
//Старый вариант с классическим масивом
//float Rolling_Avg_f(float input_sig, uint16_t averaging_num, Rolling_Avg_Statef *avg_st){
////Сохраняем предыдущие входные значения, необходимые для вычисления скользящего среднего в In_Buff[]
////Накапливаем сумму входных значений.для оптимизации вычислений не вычисляем накопленную в In_Buff[] сумму каждый
////раз заново, а замещаем последнее оставшееся значение новым входным)
//	averaging_num = (averaging_num < MAX_AVERAGING_NUM) ? averaging_num : MAX_AVERAGING_NUM;
//	avg_st->_sum += input_sig - avg_st->_In_Buff[averaging_num-1];
////Сдвигаем значения в массиве In_Buff для сохранения нового (самое старое значение, находящееся в конце массива, затирается)
//	for(int i = averaging_num-1; i > 0; i--){
//		avg_st->_In_Buff[i] = avg_st->_In_Buff[i-1];
//	}
//	avg_st->_In_Buff[0] = input_sig;
////Раз в RESET_SUM вызовов обнуляем ошибку, накопленную при вычислении sum, просто пересчитывая значения по данным в In_Buff[]
//
//#ifdef RESET_SUM
//	avg_st->_callback_num++;
//	if(avg_st->_callback_num > RESET_SUM){
//		avg_st->_callback_num = 0;
//		avg_st->_sum = 0;
//		for(int i = 0; i < averaging_num; i++){
//			avg_st->_sum += avg_st->_In_Buff[i];
//		}
//	}
//#endif
//	return (avg_st->_sum / averaging_num);
//}

/**
  * @brief  Функция сброса накопленной при вычислении среднеквадратичного значения ошибки. Перезаписывает накопленную сумму,
  * 		складывая все элементы массива с предыдущими значениями
  *
  * @note	Вызывать данную функцию допустимо в любой момент, однако если в процессе работы программы необходимо изменить rms_num
  * 		в функции RMS, то данная функция должна быть ОБЯЗАТЕЛЬНО вызвана, причем строго после изменения rms_num и до вызова
  * 		функции RMS с новым значением rms_num
  *
  * @param	rms_num				    -- Количество значений, по которым вычисляется среднеквадратичное. Должно быть кратно периоду сигнала и
  *                                    совпадать с аргументом функции RMS
  *
  * @param	RMS_State               -- Структура, хранящая прошлые отчеты - накопленную сумму, а также массив всех предыдущих значений
  *
  * @retval none
  *
  */
void Rolling_Avg_rst_err(uint16_t averaging_num, Rolling_Avg_Statef *avg_st){
	 int32_t sum = 0;		//Промежуточная переменная, предназначена для того, чтобы накопленную сумму можно было перезаписать за один раз.
	 for(int i = 0; i < averaging_num; i++){
		 sum += avg_st->_In_Buff[i];
	 }
	 //Перезаписываем сумму за один раз, чтобы избежать возможных проблем с прерыванием пересчета суммы при вызове функции RMS в прерывании
	 avg_st->_sum = sum;
}




/**
  * @brief  Функция вычисления действующего (среднеквадратичного, RMS) значения для произвольного дискретного сигнала
  * 		(https://en.wikipedia.org/wiki/Root_mean_square)
  *
  * @note	Если в процессе работы программы необходимо изменить rms_num, то ОБЯЗАТЕЛЬНО должна быть вызвана функция RMS_rst_err,
  * 		причем строго после изменения rms_num и до вызова функции RMS с новым значением rms_num. Это необходимо, так как RMS
  * 		вычисляет накопленную сумму единожды при старте, а далее  использует уже рассчитанное значение без проверок. В итоге
  * 		при уменьшении rms_num сумма останется та же, а делитель уменьшится. При увеличении rms_num такой проблемы нет.
  *
  * @note	Данная функция динамически вычисляет среднеквадратичное значение (измеренное, например, АЦП) по rms_num < MAX_RMS_NUM
  * 		дискретным отсчетам. Выходное значение пересчитывается по поступлении каждого нового отчета. Аналогична
  * 		функции усреднения, но здесь усредняется не сама величина, а ее квадрат, с последующим извлечением корня.
  * 		Вызывать данную функцию необходимо постоянно по поступлении нового значения с АЦП или т.п.
  *
  *	@note	Параметр MAX_RMS_NUM объявлен в заголовочном файле. Обратите внимание, для корректного вычисления среднеквадратичного
  *			значения периодического сигнала параметр rms_num должен быть не меньше, чем число считываний на периоде этого
  *			сигнала
  *
  * @param	input_sig				-- Входной дискретный сигнал
  *
  * @param	rms_num				    -- Количество значений, по которым вычисляется среднеквадратичное. Должно быть кратно периоду сигнала
  *                                    Может принимать значения от 0 до величины MAX_RMS_NUM, заданной в DSPlib.h
  *
  * @param	RMS_State               -- Структура, хранящая прошлые отчеты - накопленную сумму, а также массив всех предыдущих значений
  *
  * @retval RMS						-- Выходное среднеквадратичное (RMS, действующее) значение
  *
  */
int32_t RMS(int32_t input_sig, uint32_t rms_num, RMS_State *rms_st){
	rms_num = (rms_num <= MAX_RMS_NUM) ? rms_num : MAX_RMS_NUM;
	int32_t input_sig_2 = input_sig * input_sig;
	int n = rms_st->_n;
//Если число вызовов функции достигло rms_num, то сбрасываем счетчик, тем самым новые значения массива будут затирать старые
	if(n == rms_num){
		rms_st->_n = 0;
		n = 0;
	}
//Накапливаем сумму квадратов входных значений. Для оптимизации вычислений не вычисляем накопленную в In_Buff_2[]
//сумму каждый раз заново, а замещаем последнее оставшееся значение новым входным)
	rms_st->_sum_2 = rms_st->_sum_2 + input_sig_2 - rms_st->_In_Buff_2[n];
//Перезаписываем квадрат измеренного значения
	rms_st->_In_Buff_2[n] = input_sig_2;

// Увеличиваем счетчик числа вызовов функции
	(rms_st->_n) ++;
	return (int32_t)( sqrt(rms_st->_sum_2 / rms_num));
}




/**
  * @brief  Функция сброса накопленной при вычислении среднеквадратичного значения ошибки. Перезаписывает накопленную сумму,
  * 		складывая все элементы массива с предыдущими значениями
  *
  * @note	Вызывать данную функцию допустимо в любой момент, однако если в процессе работы программы необходимо изменить rms_num
  * 		в функции RMS, то данная функция должна быть ОБЯЗАТЕЛЬНО вызвана, причем строго после изменения rms_num и до вызова
  * 		функции RMS с новым значением rms_num
  *
  * @param	rms_num				    -- Количество значений, по которым вычисляется среднеквадратичное. Должно быть кратно периоду сигнала и
  *                                    совпадать с аргументом функции RMS
  *
  * @param	RMS_State               -- Структура, хранящая прошлые отчеты - накопленную сумму, а также массив всех предыдущих значений
  *
  * @retval none
  *
  */
void RMS_rst_err(uint32_t rms_num, RMS_State *rms_st){
	 int32_t sum_2 = 0;		//Промежуточная переменная, предназначена для того, чтобы накопленную сумму можно было перезаписать за один раз.
	 for(int i = 0; i < rms_num; i++){
		 sum_2 += rms_st->_In_Buff_2[i];
	 }
	 //Перезаписываем сумму за один раз, чтобы избежать возможных проблем с прерыванием пересчета суммы при вызове функции RMS в прерывании
	 rms_st->_sum_2 = sum_2;
}




/**
  * @brief  Функция вычисления действующего (среднеквадратичного, RMS) значения для произвольного дискретного сигнала типа float
  * 		(https://en.wikipedia.org/wiki/Root_mean_square)
  *
  * @note	Если в процессе работы программы необходимо изменить rms_num, то ОБЯЗАТЕЛЬНО должна быть вызвана функция RMS_f_rst_err,
  * 		причем строго после изменения rms_num и до вызова функции RMS_f с новым значением rms_num. Это необходимо, так как RMS_f
  * 		вычисляет накопленную сумму единожды при старте, а далее  использует уже рассчитанное значение без проверок. В итоге
  * 		при уменьшении rms_num сумма останется та же, а делитель уменьшится. При увеличении rms_num такой проблемы нет.
  *
  * @note	Данная функция динамически вычисляет среднеквадратичное значение  по rms_num < MAX_RMS_NUM
  * 		дискретным отсчетам. Выходное значение пересчитывается по поступлении каждого нового отчета. Аналогична
  * 		функции усреднения, но здесь усредняется не сама величина, а ее квадрат, с последующим извлечением корня.
  * 		Вызывать данную функцию необходимо постоянно по поступлении нового значения с АЦП или т.п.
  *
  *	@note	Параметр MAX_RMS_NUM объявлен в заголовочном файле. Обратите внимание, для корректного вычисления среднеквадратичного
  *			значения периодического сигнала параметр rms_num должен быть не меньше, чем число считываний на периоде этого
  *			сигнала
  *
  * @param	input_sig				-- Входной дискретный сигнал типа float
  *
  * @param	rms_num				    -- Количество значений, по которым вычисляется среднеквадратичное. Должно быть кратно периоду сигнала
  *                                    Может принимать значения от 0 до величины MAX_RMS_NUM, заданной в DSPlib.h
  *
  * @param	RMS_State_f             -- Структура, хранящая прошлые отчеты - накопленную сумму, а также массив всех предыдущих значений
  *
  * @retval RMS						-- Выходное среднеквадратичное (RMS, действующее) значение типа float
  *
  */
float RMS_f(float input_sig, uint32_t rms_num, RMS_Statef *rms_st){
	rms_num = (rms_num <= MAX_RMS_NUM) ? rms_num : MAX_RMS_NUM;
	float input_sig_2 = input_sig * input_sig;
//TODO  Введение этой локальной переменной позволило сократить время рассчета среднего для 3 фаз с 1050нс до 1015нс, так что намного выгоднее
//TODO  вводить для индекса локальную переменную, чем все время считывать значение из структуры, хотя код разарастается, а записывать и считывать переменную надо особенно аккуратно.
	int n = rms_st->_n;
//Если число вызовов функции достигло rms_num, то сбрасываем счетчик, тем самым новые значения массива будут затирать старые
	if(n == rms_num){
		rms_st->_n = 0;
		n = 0;
	}
//Накапливаем сумму квадратов входных значений. Для оптимизации вычислений не вычисляем накопленную в In_Buff_2[]
//сумму каждый раз заново, а замещаем последнее оставшееся значение новым входным)
	rms_st->_sum_2 = rms_st->_sum_2 + input_sig_2 - rms_st->_In_Buff_2[n];
//Перезаписываем квадрат измеренного значения
	rms_st->_In_Buff_2[n] = input_sig_2;

// Увеличиваем счетчик числа вызовов функции
	(rms_st->_n) ++;
	return sqrt(rms_st->_sum_2 / rms_num);
}

////Сохраняем квадраты предыдущих входных значений, необходимые для вычисления среднеквадратичного значения
//	float input_sig_2 = input_sig * input_sig;
//	rms_num = (rms_num <= MAX_RMS_NUM) ? rms_num : MAX_RMS_NUM;
////Накапливаем сумму квадратов входных значений. Для оптимизации вычислений не вычисляем накопленную в In_Buff_2[]
////сумму каждый раз заново, а замещаем последнее оставшееся значение новым входным)
//	rms_st->_sum_2 = rms_st->_sum_2 + input_sig_2 - rms_st->_In_Buff_2[rms_num-1];
////Сдвигаем значения в массиве In_Buff_2 для сохранения нового (самое старое значение, находящееся в конце массива, затирается)
//	for(int i = rms_num-1; i > 0; i--){
//		rms_st->_In_Buff_2[i] = rms_st->_In_Buff_2[i-1];
//	}
//	rms_st->_In_Buff_2[0] = input_sig_2;
//	return sqrt(rms_st->_sum_2 / rms_num);
//}




/**
  * @brief  Функция сброса накопленной при вычислении среднеквадратичного значения ошибки сигнала типа float. Перезаписывает
  * 		накопленную сумму, складывая все элементы массива с предыдущими значениями
  *
  * @note	Вызывать данную функцию допустимо в любой момент, однако если в процессе работы программы необходимо изменить rms_num
  * 		в функции RMS_f, то данная функция должна быть ОБЯЗАТЕЛЬНО вызвана, причем строго после изменения rms_num и до вызова
  * 		функции RMS_f с новым значением rms_num
  *
  * @param	rms_num				    -- Количество значений, по которым вычисляется среднеквадратичное. Должно быть кратно периоду сигнала и
  *                                    совпадать с аргументом функции RMS_f
  *
  * @param	RMS_State               -- Структура, хранящая прошлые отчеты - накопленную сумму, а также массив всех предыдущих значений
  *
  * @retval none
  *
  */
void RMS_f_rst_err(uint32_t rms_num, RMS_Statef *rms_st){
	 double sum_2 = 0;		//Промежуточная переменная, предназначена для того, чтобы накопленную сумму можно было перезаписать за один раз.
	 for(int i = 0; i < rms_num; i++){
		 sum_2 += rms_st->_In_Buff_2[i];
	 }
	 //Перезаписываем сумму за один раз, чтобы избежать возможных проблем с прерыванием пересчета суммы при вызове функции RMS в прерывании
	 rms_st->_sum_2 = sum_2;
}



/**
  * @brief  Функция вычисления действующего (среднеквадратичного, RMS) значения для синусоидального сигнала
  *
  * @note	Данная функция постоянно вычисляет действующее значение (измеренное, например, АЦП), но
  * 		обновляет его с частотой примерно в 2 раза меньшей частоты сигнала
  * 		и должна быть расположена в бесконечном цикле while с проверкой флага обновления
  * 		данных, прерывании по обновлении данных и т.п.
  *
  * @param	input_sig				-- Входной сигнал, чаще всего с АЦП
  *
  * @retval sine_RMS				-- Выходное среднеквадратичное (RMS, действующее) значение
  *
  */
int32_t Sine_RMS(int32_t input_sig){
	static int32_t Max = 0;
	static int32_t Min = pow(2,DAC_BIT_RATE);
	static float sine_RMS;
	static uint32_t cntr = 666;
//Ищем максимальное значение синусоиды,
	if(input_sig > Max){
		Max = input_sig;
		cntr = cntr + 2;
	}
//Ищем минимальное значение синусоиды
	else if(input_sig < Min){
		Min = input_sig;
		cntr = cntr + 2;
	}
//Если оба значения найдены, то декрементируем счетчик, пока он не достагнет нуля. При этом
//так как увеличивался счетчик на + 2, а уменьшается на 1, то частота обновления sine_RMS
//будет в 2 раза меньше частоты сигнала (примерно, так как есть еще дополнительная поправка
//при перезадании счетчика. (по умолчанию 1000). Чем больше отношение частоты дискретизации
// к частоте сигнала, тем больше необходимо выбирать эту поправку. В идеале она должна быть
//не меньше, чем отношение частоты дискретизации к частоте сигнала, в противном случае могут
//возникать ситуации, когда среднее вычисляется раньше, чем найден максимум или минимум,(например,
//первое измерение попало близ вершины синусоиды на участок с отрицательной производной. Тогда
//в цикле мы, пока не дойдем до низа, будем все время уменьшать счетчик без его увеличения, тем
//самым попадем раньше в рассчет действующего значения, чем найдем минимальное значение)

//TODO избавиться от поправки к значению cntr;
	else {
		cntr--;
	}
//Если счетчик равен нулю, то пересчитываем действующее значение, а затем переинициализируем значения, тем самым
//перезапуская поиск максимума и минимума.
	if(cntr == 0){
		sine_RMS = (float)(Max-Min) / SQRT2;
		cntr = 666;
		Max = 0;
		Min = pow(2,DAC_BIT_RATE);
	}

	return (int32_t)sine_RMS;
}




/************************************************************************************************************************/
/*								Динамический ограничитель скорости изменения сигнала 									*/
/************************************************************************************************************************/

/**
  * @brief  Функция динамического ограничения скорости изменения сигнала (https://studopedia.ru/20_27817_blok-ogranicheniya-skorosti-izmeneniya-signala-Rate-Limiter.html)
  *
  * @param	Rate_Limiter_Param		-- Структура, содержащая параметры динамического ограничителя скорости изменения
  * 								   сигнала - частоту считывания, верхний и нижний пороги скорости
  *
  * @retval cur_out					-- Выходной сигнал с учетом ограничения по скорости
  *
  *	@note	Для корректной работы требуется достаточно точно выдерживать время между двумя последовательными считываниями,
  *			обратное частоте дискретизации. Поэтому данная функция предполагает работу по таймеру - в обработчике
  *			прерываний или в цикле while(1) по флагу (например, окончания преобразования на АЦП с запуском по таймеру)
  *
  *	@note	Обратите внимание, что выражение up_lim / f подразумевает существование ошибки округления, в связи с чем
  *			фактическая скорость изменения сигнала может оказаться чуть больше предела. В связи с этим рекомендуется
  *			задавать верхний и нижний пороги с поправкой на это.
  *
  */
int32_t Rate_Limiter(int32_t input_sig, Rate_Limiter_Param *RL_Par){
	int32_t cur_out;
//Считаем скорость изменения сигнала (производную от сигнала)
	int32_t rate = (input_sig - RL_Par->prev_out) * RL_Par->freq;  // rate = (input_sig - prev_out) / dt , где dt = 1/freq
//Если скорость роста сигнала выше допустимой, то выходной сигнал считаем как интеграл от максимальной скорости роста со смещением prev_out
	if(rate > RL_Par->rising_lim){
		//Из-за округления фактическая скорость может оказаться выше up_lim, что необходимо учитывать при задании up_lim
		cur_out = (int32_t)(RL_Par->rising_lim / RL_Par->freq) + RL_Par->prev_out;
	}
//Если скорость спада сигнала выше допустимой (по абсолютной величине), то выходной сигнал считаем как интеграл от максимальной скорости спада со смещением prev_out
	else if(rate < - RL_Par->falling_lim){
		cur_out = - (int32_t)(RL_Par->falling_lim / RL_Par->freq) + RL_Par->prev_out;
	}
//Если скорость не выходит за пределы, то выходной сигнал равен входному
	else {
		cur_out = input_sig;
	}
//Обратите внимание, что данная логика неприменима для ограничения скорости снизу, так как в таком случае
//выходной сигнал всегда будет опережать входной, и потому расти выше максимального значения

	RL_Par->prev_out = cur_out;
	return cur_out;
}




/************************************************************************************************************************/
/*										Антидребезговая фильтрация сигнала 												*/
/************************************************************************************************************************/
//https://istarik.ru/blog/stm32/148.html



///**
//  * @brief  Функция антидребезговой фильтрации сигнала по таймеру
//  *
//  * @param	delay_ms				-- Задержка на установление сигнала в мс
//  *
//  * @param	GPIO_TypeDef			-- Структура, определяющая порт, с которого будет читаться сигнал
//  *
//  * @param	GPIO_Pin				-- Цифровой пин, с которого читается сигнал
//  *
//  * @param	TIM_HandleTypeDef		-- Структура, задающая таймер, по которому вызывается функция (время между тиками
//  * 								   	   таймера должно быть больше задержки на установление сигнала)
//  *
//  * @retval bool						-- Выходной сигнал без дребезга
//  *
//  *	@note	Функция рассчитана на использование совместно с таймером и должна вызываться каждый раз по его переполнении.
//  *			При этом таймер может использоваться не только для фильтрации, но и, например, для периодического считывания
//  *			значений с АЦП.
//  *
//  * @note	Для использования данной функции не обязательно объявлять новый таймер, она может быть использована в
//  * 		дополнение с уже инициализированным для чего-либо таймером. Нам необходимо лишь знать частоту тиков,
//  * 		которая должна быть меньше задержки на установление сигнала
//  */
//
//bool Contact_Debouncing_Tim(uint32_t delay_ms, GPIO_TypeDef *GPIOx, uint16_t GPIO_Pin, TIM_HandleTypeDef *htim){
//	static bool prev_val;
//	static uint32_t cntr;
//	bool out_signal;
//	bool input_sig = HAL_GPIO_ReadPin(GPIOx, GPIO_Pin);
//	if( (prev_val ^ input_sig)&&(cntr == 0) ){		//Операция XOR. Если текущий отчет отличается от предыдущего и предыдущая итерация антидребезговой фильтрации окончена (cntr == 0)
////Находим произведение частоты переполнения таймера и времени задержки в секундах, что соответствует числу тиков, которые должен
////сделать таймер, чтобы прошло delay_ms / 1000 секунд
//		cntr = (CORE_FREQ / (htim->Init.Prescaler * htim->Init.Period)) * (delay_ms / 1000.);
//	}
////По каждому переполнению таймера уменьшаем cntr, пока не дойдем до нуля. За это время, равное delay_ms, дребезг должен пройти
//	if(cntr > 0){
//		cntr--;
//	}
//	else if (cntr == 0){
//		out_signal = input_sig;
//	}
//	prev_val = input_sig;
//	return out_signal;
//}





///**
//  * @brief  Функция побитовой антидребезговой фильтрации сигнала в соответствии с заданной маской
//  *
//  * @note	Маска определяет, какие именно биты из всего всех битов входного сигнала мы фильтруем.
//  * 		Данный подход позволяет определять разные времена фильтрации для разных битов одного и
//  * 		того же входного сигнала.
//  *
//  * @note	Данная функция должна периодически вызываться пользователем по таймеру, в основном цикле и т.п.
//  *
//  * @param	input					-- Входной сигнал с дребезгом
//  *
//  * @param	Bit_Debounce_Param		-- Структура с параметрами блока побитовой антидребезговой фильтрации. Содержит
//  * 								       задаваемые пользователем маску и число вызовов для стабилизации выходного
//  * 								       сигнала, а также служебные переменные, сохраняющие значения между вызовами.
//  *
//  *
//  * @retval uint32_t					-- Выходной сигнал без дребезга. По окончании дребезга задержка выходного сигнала
//  * 									   составит не более stbl_num в зависимости от сигнала.
//  */
//uint32_t Debounce(uint32_t input, Debounce_Param * debounce_par){
//	if( input &  debounce_par->mask == debounce_par->prev_input_ & debounce_par->mask ){
//		debounce_par->cntr_ ++;
//	}
///*Здесь можно как вычитать значения , так и обнулять счетчик. Обнулении дает большую задержку, но при этом при правильной
//настройке (т.е когда постоянная времени блока больше периода дребезга) наиболее безопасно. Декрементирование счетчика при
//различии сигналов даст более быструю реакцию, но зачастую возможны и ошибки определения уровня сигнала. Например, при высокой
//частоте опроса cntr_ может постоянно увеличиваться в процессе дребезга, если постоянные высокий и низкий уровни держатся,
//например, 2 тика, а переход между ними - 1 тик */
////	else if( debounce_par->cntr_  > 0){
////		debounce_par->cntr_ --;
////	}
//	else debounce_par->cntr_ = 0;
//	debounce_par->prev_input_ = input;
//
////Если в течение stbl_num держится одно и то же входное значение, то запоминаем его и выводим. Иначе выводим предыдущее выходное отфильтрованное
//	if( debounce_par->cntr_ == debounce_par->stbl_num ){
//		debounce_par->prev_output_  = input;
//		debounce_par->cntr_ = 0;
//		return input;
//	}
//	return debounce_par->prev_output_;
//}


